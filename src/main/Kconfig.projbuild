## src/main/Kconfig.projbuild
```kconfig
menu "Configuração do Wifi"
  config ESP_WIFI_SSID
    string "WiFi SSID"
    default "nome_do_wifi"
    help
      Nome do Wifi.

  config ESP_WIFI_PASSWORD
    string "Senha do Wifi"
    default "senha_forte"
    help
      Senha do WiFi.

  config ESP_MAXIMUM_RETRY
    int "Máximo de tentativas para conexão"
    default 5
    help
      Configure o valor máximo de tentativas para conexão.
endmenu

menu "Configuração Display LCD"

  config I2C_MASTER_SCL
      int "SCL GPIO Num"
      default 6 if IDF_TARGET_ESP32C3
      default 19 if IDF_TARGET_ESP32 || IDF_TARGET_ESP32S2 || IDF_TARGET_ESP32S3
      help
          GPIO number for I2C Master clock line.

  config I2C_MASTER_SDA
      int "SDA GPIO Num"
      default 5 if IDF_TARGET_ESP32C3
      default 18 if IDF_TARGET_ESP32 || IDF_TARGET_ESP32S2 || IDF_TARGET_ESP32S3
      help
          GPIO number for I2C Master data line.

endmenu
```
